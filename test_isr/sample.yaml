## test_isr/sample.yaml
```yaml
sample:
  name: Tests_isr Sample
tests:
  sample.basic.blinky:
    tags:
      - threads
      - gpio
      - isr
    filter: dt_enabled_alias_with_parent_compat("led0", "gpio-leds")
    depends_on: gpio
    harness: led
    integration_platforms:
      - frdm_k64f
```
